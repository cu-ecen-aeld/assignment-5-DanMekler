## base_external/package/aesd-assignments/Config.in
```kconfig
config BR2_PACKAGE_AESD_ASSIGNMENTS
	bool "aesd-assignments"
	help
	Cross-compiles and installs the aesdsocket application
      	with its init script for the target.
```
